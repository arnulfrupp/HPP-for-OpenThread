## CMakeLists.txt
```
#
# Halloween
#

cmake_minimum_required(VERSION 3.13.1)

list(INSERT OVERLAY_CONFIG 0 $ENV{ZEPHYR_BASE}/../nrf/samples/openthread/common/overlay-ot-defaults.conf)

find_package(Zephyr REQUIRED HINTS $ENV{ZEPHYR_BASE})

project(halloween)

target_sources(app PRIVATE src/main.c)
target_sources(app PRIVATE src/hppVarStorage.c)
target_sources(app PRIVATE src/hppParser.c)
target_sources(app PRIVATE src/hppThread.c)
target_sources(app PRIVATE src/hppZephyr.c)
target_sources_ifdef(CONFIG_HPP_NRF52840 app PRIVATE src/hppNRF52840.c)

#target_sources_ifdef(CONFIG_BT_NUS app PRIVATE src/ble_utils.c)
```

## Kconfig
```
#
# Halloween
#

menu "Zephyr Kernel"
source "Kconfig.zephyr"
endmenu

module = HALLOWEEN_ZEPHYR
module-str = zephyr utilities and H++ commands
source "${ZEPHYR_BASE}/subsys/logging/Kconfig.template.log_config"

# module = BLE_UTILS
# module-str = Bluetooth connection utilities
# source "${ZEPHYR_BASE}/subsys/logging/Kconfig.template.log_config"


# Halloween Options 
# -----------------

config HPP_NRF52840
	bool "Enable support for nRF52840 specific features (PWM)"
	select NRFX_PWM0
	default n
```

## prj.conf
```kconfig
#
# Halloween
#

# Lager main stack for H++ parsing
CONFIG_MAIN_STACK_SIZE=4096

# Configure sample logging setting
CONFIG_HALLOWEEN_ZEPHYR_LOG_LEVEL_DBG=y

# Network shell
CONFIG_NET_SHELL=y
CONFIG_SHELL_ARGC_MAX=26
CONFIG_SHELL_CMD_BUFF_SIZE=416

# OpenThread settings
CONFIG_OPENTHREAD_MANUAL_START=y
CONFIG_OPENTHREAD_COAP=y
CONFIG_OPENTHREAD_COAPS=y
CONFIG_OPENTHREAD_JOINER=y
CONFIG_OPENTHREAD_COMMISSIONER=y
CONFIG_OPENTHREAD_SLAAC=y

# Zephyr IO settings
CONFIG_STDOUT_CONSOLE=y
CONFIG_GPIO=y
CONFIG_USB=y
CONFIG_USB_DEVICE_STACK=y
CONFIG_USB_DEVICE_PRODUCT="Halloween H++ Device"
CONFIG_LOG=y
CONFIG_USB_DRIVER_LOG_LEVEL_ERR=y
CONFIG_USB_CDC_ACM=y
CONFIG_USB_DEVICE_LOG_LEVEL_ERR=y
CONFIG_SERIAL=y
CONFIG_UART_INTERRUPT_DRIVEN=y
CONFIG_UART_LINE_CTRL=y

# Helloween options
CONFIG_HPP_NRF52840=y
```

## src/main.c
```c
/* ----------------------------------------------------------------------------	*/
/* Halloween++														            */
/* ----------------------------------------------------------------------------	*/
/* Open source scripting language for microcontrollers and embedded	            */
/* systems.															            */
/* Invented for remote controlled Halloween ghosts and candles :-)	            */
/* ----------------------------------------------------------------------------	*/
/* File: main.c														            */
/* ----------------------------------------------------------------------------	*/
/* OpenThread Support Library - main file							            */
/*																	            */
/*   - Initialization Halloween library 							            */
/*   - Load demo scripts 														*/
/*   - Runs scripts in in flash memory (if present)					            */
/*   - Runs demo scripts if no other scripts are stored in flash memory 		*/
/* ----------------------------------------------------------------------------	*/
/* Platform: Zephire RTOS with OpenThread			  				            */
/* Nordic SDK Version: Connect SDK v1.4.1	       								*/
/* ----------------------------------------------------------------------------	*/
/* Copyright (c) 2018 - 2021, Arnulf Rupp							            */
/* arnulf.rupp@web.de												            */
/* All rights reserved.												            */
/* 	                                                                            */
/* Redistribution and use in source and binary forms, with or without           */
/* modification, are permitted provided that the following conditions are met:  */
/* 	                                                                            */
/* 1. Redistributions of source code must retain the above copyright notice,    */
/* this list of conditions and the following disclaimer.                        */
/* 	                                                                            */
/* 2. Redistributions in binary form must reproduce the above copyright notice, */
/* this list of conditions and the following disclaimer in the documentation    */
/* and/or other materials provided with the distribution.                       */
/* 	                                                                            */
/* THIS SOFTWARE IS PROVIDED BY THE COPYRIGHT HOLDERS AND CONTRIBUTORS "AS IS"  */
/* AND ANY EXPRESS OR IMPLIED WARRANTIES, INCLUDING, BUT NOT LIMITED TO, THE    */
/* IMPLIED WARRANTIES OF MERCHANTABILITY AND FITNESS FOR A PARTICULAR PURPOSE   */
/* ARE DISCLAIMED. IN NO EVENT SHALL THE COPYRIGHT HOLDER OR CONTRIBUTORS BE    */
/* LIABLE FOR ANY DIRECT, INDIRECT, INCIDENTAL, SPECIAL, EXEMPLARY, OR          */
/* CONSEQUENTIAL DAMAGES (INCLUDING, BUT NOT LIMITED TO, PROCUREMENT OF         */
/* SUBSTITUTE GOODS OR SERVICES; LOSS OF USE, DATA, OR PROFITS; OR BUSINESS     */
/* INTERRUPTION) HOWEVER CAUSED AND ON ANY THEORY OF LIABILITY, WHETHER IN      */
/* CONTRACT, STRICT LIABILITY, OR TORT (INCLUDING NEGLIGENCE OR OTHERWISE)      */
/* ARISING IN ANY WAY OUT OF THE USE OF THIS SOFTWARE, EVEN IF ADVISED OF       */
/* THE POSSIBILITY OF SUCH DAMAGE.                                              */
/* ----------------------------------------------------------------------------	*/

//#include <stdio.h>
//#include <stdbool.h>
//#include <string.h>

// Halloween Libraries 

// Include H++ scripting libraries
#include "../include/hppVarStorage.h"
#include "../include/hppParser.h"

// Include Thread and Zephyr support libraries
#include "../include/hppThread.h"
#include "../include/hppZephyr.h"


// --------------
// Initialization
// --------------

void LoadDemoScripts()
{
	// initialize LED peripherals, green led and RGB led (RGB LED not used in demo scripts)
	hppVarPutStr("init_led", 	"LED_state = 0;\n"
								"//Led1 = 6; Led2r = 8; Led2g = io_pin(1, 9); Led2b = 12;\n\n"
								"//io_set(6, 0);\n"
								"//io_set(Led2r, 1);\n"
								"//io_set(Led2g, 1);\n"
								"//io_set(Led2b, 1);\n\n"
								"//io_cfg_output(6);\n"
								"//io_cfg_output(Led2r);\n"
								"//io_cfg_output(Led2g);\n"
								"//io_cfg_output(Led2b);\n"
								"io_cfg_output(13);\n"
								"io_set(13, 0);\n",
								NULL);

	// Deactivate blinking and switch LED off
	hppVarPutStr("led_off", 	"io_pwm_stop();\n"
								"timer_stop(0);\n"
								"LED_state = 1;\n"
								"io_set(6, 1);", NULL);

	// Toggle LED. This function is also used as a hander for the timer and for the coap 'toggle' ressource
	hppVarPutStr("switch_led", 	"LED_state = 1 - ?LED_state;\n"
	                           	"io_set(6, LED_state);\n", 
				 				NULL);

	// PWM peripheral example
	hppVarPutStr("do_pwm", 		"timer_stop(0);\n"
								"sqr = 'return param1 * param1;';\n"
								"PWM::alloc(252 * 2);\n"
	                            "while(?i < 126) PWM:uint16[i] = sqr(i++);\n"
								"while(i <= 252) PWM:uint16[i] = sqr(252 - i++));\n"
	                           	"io_pwm_start(16000, PWM, 20, 1000, 6);\n"
								"FirstToggle = true;\n", 
				 				NULL);

	// Demostration for how to save and delete code and global variables to flash memory 
	hppVarPutStr("save_all", 	"flash_save_code();\n"
								"flash_save();\n",
				 				NULL);
	hppVarPutStr("delete_all", 	"flash_delete_code();\n"
								"flash_delete();\n",
				 				NULL);

	// Parse CLI command for 'mycmd' command 
	hppVarPutStr("cli_parse", 	"cli_writeln('receive user command: ' ~ command ~ ' with ' ~ argc ~ ' argument(s)');\n" , NULL);

	// Handlers for button push
	hppVarPutStr("btn_push", 	"coap_put('ff03::fc', 'toggle', '', false);\n"   // addr (=> mulitcast to all CoAP nodes), path, payload, confirm (false => multicast shall not be confirmed) 
								"toggle_handler();", 							 // also switch own LED
								NULL);   

	hppVarPutStr("btn_release", "//cli_writeln('button ' ~ pin ~ ' released after ' ~ hold_time ~ ' ms');\n" , NULL);

	// CoAP handler responding to a GET and switching in PWM on a post
	hppVarPutStr("hello_handler",	"if(coap_is_get()) coap_respond('Hello H++ world');\n"
									"if(coap_is_post()) do_pwm();\n",
				 					NULL);

	// CoAP PUT handler switch off PWM and timer on first call and toggling the LED on next call
	hppVarPutStr("toggle_handler",	"if(FirstToggle)\n"
									"{\n"
									"	FirstToggle = false;\n"
									"	led_off();\n"
									"}\n\n"
									"switch_led();\n", 
									NULL);
									

	// Address registration must be done after the nework is up (prefix received from the boader router)
	hppVarPutStr("registration_handler", "ip_add_addr('fd11:22::100');\n", NULL);	 	// STABLE IP ADDRESS -> CHANGE IID (1xx) TO GIVE ALL DEVICES A UNIQUE IPv6 ADDRESS							 

	/* 
	// Initialization script
	hppVarPutStr("startup", 	"init_led();\n"
								"timer_start(0, 1000, 'switch_led');\n" 				// timer 0 is used for blinking LED
								"cli_add_cmd('mycmd');\n"
								"io_cfg_btn();\n"  										// default is pin 38 (USB dongle top button: port 1 pin 6 ==> 38)   
								"timer_once(1, 3000, 'registration_handler');\n"  	   	// register stable IP address device receifed network data  (after 3 sec) using timer 1
								"coap_add_resource('stop_blinking', 'rt=xyz', 'led_off');\n"
								"FirstToggle = true;\n"
								"coap_add_resource('toggle', '', 'toggle_handler');\n"
								"coap_add_resource('hello', '', 'hello_handler');\n"
								"//Var_Hide_PW = 'password';\n"
								"//coap_hide_vars(true);\n", NULL);
	*/


	// CLI output handler
	hppVarPutStr("cli_out",     "writeln('received:' ~ cli_output);\n", NULL);

	// CLI output handler
	hppVarPutStr("cli_send2",     "cli_put('state', 'cli_out');\n", NULL);

	// CLI output handler
	hppVarPutStr("cli_send",     "cli_put('state');\n", NULL);

	// Initialization script
	hppVarPutStr("startup", 	"init_led();\n"
								"a = 1;\n"
								"b = 2;\n"
								"writeln('Hello World');\n"
								"writeln(a + b);\n"
								"coap_add_resource('hello', '', 'hello_handler');\n"
								"a = ip_get_eid();\n"
								"writeln('eid:' ~ a);\n", NULL);
}

// -------------
// Main
// -------------

void main(void)
{
	// Initialize Thread and neccessary other libraries
	hppThreadInit();
	hppZephyrInit();
	//hppNRF52840Init();

  	//Read code from flash memory if ID matches with predefined ID
    if(hppReadVarFromFlash(false) == false)	LoadDemoScripts();    // Load demos script if no code was in the flash memory
	//LoadDemoScripts(); 


	hppAsyncParseVar("startup");
	
	// Start main loop (returns immediatelly in case of Zephire)
	hppMainLoop();
}
```

## include/hppNRF52840.h
```c
/* ----------------------------------------------------------------------------	*/
/* Halloween++														            */
/* ----------------------------------------------------------------------------	*/
/* Open source scripting language for microcontrollers and embedded	            */
/* systems.															            */
/* Invented for remote controlled Halloween ghosts and candles :-)	            */
/* ----------------------------------------------------------------------------	*/
/* File: hppNRF52840.h												            */
/* ----------------------------------------------------------------------------	*/
/* OpenThread Support Library										            */
/*																	            */
/*   - PWM library              	       							           	*/
/* ----------------------------------------------------------------------------	*/
/* Platform: Zephyr RTOS with Nordic nRF52840						            */
/* Nordic SDK Version: Connect SDK v1.5.1	       								*/
/* ----------------------------------------------------------------------------	*/
/* Copyright (c) 2018 - 2021, Arnulf Rupp							            */
/* arnulf.rupp@web.de												            */
/* All rights reserved.												            */
/* 	                                                                            */
/* Redistribution and use in source and binary forms, with or without           */
/* modification, are permitted provided that the following conditions are met:  */
/* 	                                                                            */
/* 1. Redistributions of source code must retain the above copyright notice,    */
/* this list of conditions and the following disclaimer.                        */
/* 	                                                                            */
/* 2. Redistributions in binary form must reproduce the above copyright notice, */
/* this list of conditions and the following disclaimer in the documentation    */
/* and/or other materials provided with the distribution.                       */
/* 	                                                                            */
/* THIS SOFTWARE IS PROVIDED BY THE COPYRIGHT HOLDERS AND CONTRIBUTORS "AS IS"  */
/* AND ANY EXPRESS OR IMPLIED WARRANTIES, INCLUDING, BUT NOT LIMITED TO, THE    */
/* IMPLIED WARRANTIES OF MERCHANTABILITY AND FITNESS FOR A PARTICULAR PURPOSE   */
/* ARE DISCLAIMED. IN NO EVENT SHALL THE COPYRIGHT HOLDER OR CONTRIBUTORS BE    */
/* LIABLE FOR ANY DIRECT, INDIRECT, INCIDENTAL, SPECIAL, EXEMPLARY, OR          */
/* CONSEQUENTIAL DAMAGES (INCLUDING, BUT NOT LIMITED TO, PROCUREMENT OF         */
/* SUBSTITUTE GOODS OR SERVICES; LOSS OF USE, DATA, OR PROFITS; OR BUSINESS     */
/* INTERRUPTION) HOWEVER CAUSED AND ON ANY THEORY OF LIABILITY, WHETHER IN      */
/* CONTRACT, STRICT LIABILITY, OR TORT (INCLUDING NEGLIGENCE OR OTHERWISE)      */
/* ARISING IN ANY WAY OUT OF THE USE OF THIS SOFTWARE, EVEN IF ADVISED OF       */
/* THE POSSIBILITY OF SUCH DAMAGE.                                              */
/* ----------------------------------------------------------------------------	*/


#ifndef __INCL_HPP_NRF52840_
#define __INCL_HPP_NRF52840_

#include <stdbool.h>
#include <stdint.h>
#include <stddef.h>


// --------------------
// PWM Functions 
// --------------------

// Start a PMW Sequence for up to four GIO pins (-1 = not active).
// The frequency is 16MHz / uiCountStop. Duty cycle values are provided in the array puiSeqence in groups of 
// one, two or four duty cycle values in uint16_t format, depending on how many pins are active.
// If only iPin1 is activ (>= 0) than one uint16_t is consumed per sequence to set the PWM value for pin1.
// If iPin1 and iPin2 are active but not iPin3 and iPin4, two uint16_t are consumed per sequence respectively.
// Otherwise always(!) four uint16_t are consumed. The use of three channels is not possible by a hardware restriction
// even if iPin4 is not activ (-1). 

// The cSequenceLen is the number of sequence values (1x, 2x or 4x uint16_t values respectively) provided.
// The values are not buffered. Therefore puiSeqence must remain in RAM wihile PWM is active.
// Duty cycle values range from 0 to uiCountStop (100%). 
// Every PWM setting is repeated 'uiStepRepeat' times until the next values are taken. If 'uiStepRepeat' is null then
// the PMW values are static. The Sequence is repeated uiLoop times (uiLoop = 0 --> no Loop)
// If uiLoop is >0 cSequenceLen must be minimum 8 (two value groups).
void hppStartPWM(unsigned int uiCountStop, int iPin1, int iPin2, int iPin3, int iPin4, uint16_t* puiSeqence, size_t cSequenceLen, unsigned int uiStepRepeat, unsigned int uiLoop);

void hppRestartPWM();

void hppStopPWM();

#endif
```

## include/hppParser.h
```c
/* ----------------------------------------------------------------------------	*/
/* Halloween++														            */
/* ----------------------------------------------------------------------------	*/
/* Open source scripting language for microcontrollers and embedded	            */
/* systems.															            */
/* Invented for remote controlled Halloween ghosts and candles :-)	            */
/* ----------------------------------------------------------------------------	*/
/* File: hppParser.h												            */
/* ----------------------------------------------------------------------------	*/
/* Halloween++ (H++) Parser										            	*/
/*																	            */
/*   - Core parser code 											            */
/*   - Build in math, string and enconding functions				          	*/
/*   - Build in methodes for methods for memory management and var enumeration	*/
/* ----------------------------------------------------------------------------	*/
/* Platform: POSIX and alike											        */
/* Dependencies: hppVarStorage.h										        */
/* Dependencies: int is expected to be int32_t. Verify hppAtoX and hppXXtoA.    */
/* ----------------------------------------------------------------------------	*/
/* Copyright (c) 2018 - 2021, Arnulf Rupp							            */
/* arnulf.rupp@web.de												            */
/* All rights reserved.												            */
/* 	                                                                            */
/* Redistribution and use in source and binary forms, with or without           */
/* modification, are permitted provided that the following conditions are met:  */
/* 	                                                                            */
/* 1. Redistributions of source code must retain the above copyright notice,    */
/* this list of conditions and the following disclaimer.                        */
/* 	                                                                            */
/* 2. Redistributions in binary form must reproduce the above copyright notice, */
/* this list of conditions and the following disclaimer in the documentation    */
/* and/or other materials provided with the distribution.                       */
/* 	                                                                            */
/* THIS SOFTWARE IS PROVIDED BY THE COPYRIGHT HOLDERS AND CONTRIBUTORS "AS IS"  */
/* AND ANY EXPRESS OR IMPLIED WARRANTIES, INCLUDING, BUT NOT LIMITED TO, THE    */
/* IMPLIED WARRANTIES OF MERCHANTABILITY AND FITNESS FOR A PARTICULAR PURPOSE   */
/* ARE DISCLAIMED. IN NO EVENT SHALL THE COPYRIGHT HOLDER OR CONTRIBUTORS BE    */
/* LIABLE FOR ANY DIRECT, INDIRECT, INCIDENTAL, SPECIAL, EXEMPLARY, OR          */
/* CONSEQUENTIAL DAMAGES (INCLUDING, BUT NOT LIMITED TO, PROCUREMENT OF         */
/* SUBSTITUTE GOODS OR SERVICES; LOSS OF USE, DATA, OR PROFITS; OR BUSINESS     */
/* INTERRUPTION) HOWEVER CAUSED AND ON ANY THEORY OF LIABILITY, WHETHER IN      */
/* CONTRACT, STRICT LIABILITY, OR TORT (INCLUDING NEGLIGENCE OR OTHERWISE)      */
/* ARISING IN ANY WAY OUT OF THE USE OF THIS SOFTWARE, EVEN IF ADVISED OF       */
/* THE POSSIBILITY OF SUCH DAMAGE.                                              */
/* ----------------------------------------------------------------------------	*/

#ifndef __INCL_HPP_PARSER_
#define __INCL_HPP_PARSER_

#include <stdbool.h>
#include <stdint.h>
#include <stdlib.h>


#define HPP_ERROR_CODE_MIN 200              // Programatic Errors, not including timeout
#define HPP_CALL_FUNCTION_NAME_MAX_LEN 20   // maximum lenght of function names (for error reporting only)

#define HPP_PARAM_PREFIX "%04x:param1"
#define HPP_PARAM_PREFIX_LEN 11

#define HPP_EXP_STACK_SIZE 800


enum hppReturnReasonEnum { hppReturnReason_None, hppReturnReason_Return, hppReturnReason_Break, hppReturnReason_Continue, hppReturnReason_EOF =100,
						   hppReturnReason_Timeout =150, hppReturnReason_FatalError = HPP_ERROR_CODE_MIN, 
						   hppReturnReason_Error_BreakWithoutWhile, hppReturnReason_Error_ContinueWithoutWhile, hppReturnReason_Error_ClosingBracketExpected,
						   hppReturnReason_Error_ClosingAngleBracketsExpected, hppReturnReason_Error_UnknownVariable, hppReturnReason_Error_BooleanValueExpected, 
						   hppReturnReason_Error_ClosingSquaredBracketExpected, hppReturnReason_Error_SemicolonExpected, hppReturnReason_Error_InvalidOperator,
						   hppReturnReason_Error_MissingArgument, hppReturnReason_Error_DivisionByZero, hppReturnReason_Error_FirstOperand_BooleanValueExpected,
						   hppReturnReason_Error_SecondOperand_BooleanValueExpected, hppReturnReason_Error_UnknownFunctionName, hppReturnReason_Error_CannotCallMethodOnResult,
						   hppReturnReason_Error_UnknownArrayType, hppReturnReason_Error_OpeningSquaredBracketExpected, hppReturnReason_StructVarNameTooLong,
						   hppReturnReason_Error_UnknownMemberType, hppReturnReason_Error_StackOverflow };


enum hppExternalPollFunctionEventEnum { hppExternalPollFunctionEvent_Begin, hppExternalPollFunctionEvent_Poll, hppExternalPollFunctionEvent_End }; 

struct hppParseExpressionStruct
{
	const char* szCode;
	char* szExpressionStack;
	char* szExpressionStackPointer;
	size_t cbPos;
	unsigned int iCallDepth;
	unsigned int iFunctionCallDepth;
	enum hppReturnReasonEnum eReturnReason;
	char szErrorCallFunctionName[HPP_CALL_FUNCTION_NAME_MAX_LEN + 1];
	size_t cbErrorCallFunctionPos;
	unsigned int uiExternalPollFunctionTickCount;
	uint32_t uiExternalTimer;
};


// Function Pointer for external Librarys 
typedef char* (*hppExternalFunctionType)(char*, char*, const char*, size_t*);
typedef void (*hppExternalPollFunctionType)(struct hppParseExpressionStruct*, enum hppExternalPollFunctionEventEnum);


// Parse H++ code in 'aszCode' and store return value in the variable 'aszResultVarKey'. Returns a pointer to
// the char array assoziated with that variable 'aszResultVarKey'.
// If the string value of 'aszResultVarKey' equals "ReturnWithError", an error text is created in cas of a parse
// error. Otherwise the result in NULL in case of a parse error. 
char* hppParseExpression(const char* aszCode, const char* aszResultVarKey);

// Add an external function library 
bool hppAddExternalFunctionLibrary(hppExternalFunctionType aExternalFunctionType);

// Add an external poll function which shall be called regularly while parsing h++ code
// Returns an existing poll function, if it exists. Otherwhise returns NULL 
hppExternalPollFunctionType hppAddExternalPollFunction(hppExternalPollFunctionType aNewExternalPollFunction);

#endif
```

## include/hppThread.h
```c
/* ----------------------------------------------------------------------------	*/
/* Halloween++														            */
/* ----------------------------------------------------------------------------	*/
/* Open source scripting language for microcontrollers and embedded	            */
/* systems.															            */
/* Invented for remote controlled Halloween ghosts and candles :-)	            */
/* ----------------------------------------------------------------------------	*/
/* File: hppThread.h												            */
/* ----------------------------------------------------------------------------	*/
/* OpenThread Support Library										            */
/*																	            */
/*   - Initialization and resource managment						            */
/*   - CoAP support functions										            */
/*   - hppVarStorage bindings (PUT, GET var/x)                                  */
/*   - hppParser bindings (POST var/x)                                          */
/* ----------------------------------------------------------------------------	*/
/* Platform: OpenThread integrated in Zephire RTOS  				            */
/* Nordic SDK Version: Connect SDK v1.5.1	       								*/
/* ----------------------------------------------------------------------------	*/
/* Copyright (c) 2018 - 2021, Arnulf Rupp							            */
/* arnulf.rupp@web.de												            */
/* All rights reserved.												            */
/* 	                                                                            */
/* Redistribution and use in source and binary forms, with or without           */
/* modification, are permitted provided that the following conditions are met:  */
/* 	                                                                            */
/* 1. Redistributions of source code must retain the above copyright notice,    */
/* this list of conditions and the following disclaimer.                        */
/* 	                                                                            */
/* 2. Redistributions in binary form must reproduce the above copyright notice, */
/* this list of conditions and the following disclaimer in the documentation    */
/* and/or other materials provided with the distribution.                       */
/* 	                                                                            */
/* THIS SOFTWARE IS PROVIDED BY THE COPYRIGHT HOLDERS AND CONTRIBUTORS "AS IS"  */
/* AND ANY EXPRESS OR IMPLIED WARRANTIES, INCLUDING, BUT NOT LIMITED TO, THE    */
/* IMPLIED WARRANTIES OF MERCHANTABILITY AND FITNESS FOR A PARTICULAR PURPOSE   */
/* ARE DISCLAIMED. IN NO EVENT SHALL THE COPYRIGHT HOLDER OR CONTRIBUTORS BE    */
/* LIABLE FOR ANY DIRECT, INDIRECT, INCIDENTAL, SPECIAL, EXEMPLARY, OR          */
/* CONSEQUENTIAL DAMAGES (INCLUDING, BUT NOT LIMITED TO, PROCUREMENT OF         */
/* SUBSTITUTE GOODS OR SERVICES; LOSS OF USE, DATA, OR PROFITS; OR BUSINESS     */
/* INTERRUPTION) HOWEVER CAUSED AND ON ANY THEORY OF LIABILITY, WHETHER IN      */
/* CONTRACT, STRICT LIABILITY, OR TORT (INCLUDING NEGLIGENCE OR OTHERWISE)      */
/* ARISING IN ANY WAY OUT OF THE USE OF THIS SOFTWARE, EVEN IF ADVISED OF       */
/* THE POSSIBILITY OF SUCH DAMAGE.                                              */
/* ----------------------------------------------------------------------------	*/

#ifndef __INCL_HPP_THREAD_
#define __INCL_HPP_THREAD_


// ATTENTION - Thread safety:
// Functions in this library are usually called from an openthread callback, thus from openthread context
// Calling functions from outside requires locking the openthread mutex with:
//
// openthread_api_mutex_lock(hppOpenThreadContext);
// function call(s)
// openthread_api_mutex_unlock(hppOpenThreadContext);


#include <stdbool.h>
#include <ctype.h>

// Thread
#include <openthread/thread.h>
#include <openthread/ip6.h>
#include <openthread/coap.h>
#include <openthread/coap_secure.h>


// Settings
#define HPP_COAPS_PSK_MAX_LEN 32
#define HPP_COAPS_ID_MAX_LEN 32

#define HPP_HIDE_VAR_RESOURCE_PASSWORD "openvar"


// -----------------------
// Global Variables
// -----------------------

extern struct openthread_context *hppOpenThreadContext;
extern otInstance *hppOpenThreadInstance;               // hppOpenThreadContext->instance

// Hiding variables
extern bool hppHideVarResources;
      

//  CoAP message context for a delayed answer
struct hppCoapMessageContextStruct
{
    char szHeaderText[9];    // holds the text 'context:' to indicate a valid context
    otMessageInfo mMessageInfo;
    otCoapType mCoapType;
    otCoapCode mCoapCode;
    uint8_t mCoapMessageTokenLength;
    uint8_t mCoapMessageToken[OT_COAP_MAX_TOKEN_LENGTH];
    uint8_t mHasResponded;
};

typedef struct hppCoapMessageContextStruct hppCoapMessageContext;

// Current CoAP context for coap_respond() H++ command 
extern hppCoapMessageContext hppMyCurrentCoapMessageContext;


// -----------------------
// Send CoAP Messages
// -----------------------

// Send CoAP Message with CoAP code aCoapCode to URI aszUriPathAddress/aszUriPathOptions. Include Payload if acbPayloadLen > 0. 
// Any resonse will be send to aResponseHandler if other than NULL. Both Confirmable and Non Confirmabe is supported. 
// The pointer aContext will be send to the aResponseHandler e.g. for request-response mapping.
otError hppCoapSend(const char* aszUriPathAddress, const char* aszUriPathOptions, const char* apPayload, size_t acbPayloadLen, otCoapCode aCoapCode, 
                    otCoapResponseHandler aResponseHandler, void* aContext, bool abConfirmable);

// Send CoAP PUT Message to URI apUriPathAddress/apUriPathOptions. Include Payload if cbPayloadLen > 0. 
// Both Confirmable and Non Confirmabe is supported. 
otError hppCoapPUT(const char* aszUriPathAddress, const char* aszUriPathOptions, const char* apPayload, size_t acbPayloadLen, bool abConfirmable);

// Send CoAP PUT Message to URI apUriPathAddress/apUriPathOptions. Include payload string apPayloadString if strlen(apPayloadString) > 0. 
// Both Confirmable and Non Confirmabe is supported. 
otError hppCoapStringPUT(const char* aszUriPathAddress, const char* aszUriPathOptions, const char* aszPayloadString, bool abConfirmable);

// Send CoAP GET Message to URI apUriPathAddress/apUriPathOptions.  
// Any resonse will be send to aResponseHandler if other than NULL. Both Confirmable and Non Confirmabe is supported. 
// The pointer aContext will be send to the aResponseHandler e.g. for request-response mapping.
otError hppCoapGET(const char* aszUriPathAddress, const char* aszUriPathOptions, otCoapResponseHandler aResponseHandler, void* aContext, bool abConfirmable);

// Send CoAP POST Message to URI apUriPathAddress/apUriPathOptions. Include Payload if cbPayloadLen > 0. 
// Any resonse will be send to aResponseHandler if other than NULL. Both Confirmable and Non Confirmabe is supported. 
// The pointer aContext will be send to the aResponseHandler e.g. for request-response mapping.
otError hppCoapPOST(const char* aszUriPathAddress, const char* aszUriPathOptions, const char* apPayload, size_t acbPayloadLen, otCoapResponseHandler aResponseHandler, void* aContext, bool abConfirmable);

// Send CoAP POST Message to URI apUriPathAddress/apUriPathOptions. Include payload string apPayloadString if strlen(apPayloadString) > 0. 
// Any resonse will be send to aResponseHandler if other than NULL. Both Confirmable and Non Confirmabe is supported. 
// The pointer aContext will be send to the aResponseHandler e.g. for request-response mapping.
otError hppCoapStringPOST(const char* aszUriPathAddress, const char* aszUriPathOptions, const char* aszPayloadString, otCoapResponseHandler aResponseHandler, void* aContext, bool abConfirmable);

// -----------------------
// Receive CoAP Messages
// -----------------------

// Check if incomming a CoAP message has the specified code 
bool hppIsCoapCode(otMessage* apMessage, otCoapCode aCoapCode);

// Check if a CoAP message is an inital type message (confirmable or non confirmable) and is a PUT/GET/POST/DELETE message respectively  
bool hppIsCoapPUT(otMessage* apMessage);
bool hppIsCoapGET(otMessage* apMessage);
bool hppIsCoapPOST(otMessage* apMessage);
bool hppIsCoapDELETE(otMessage* apMessage);

// Read CoAP Playload into a buffer with up to aLenght bytes. Returns the acutal number of bytes read
int hppCoapReadPayload(otMessage *apMessage, void *apBuf, uint16_t aLength);

// Get CoAP Playload lenght 
int hppCoapGetPayloadLenght(otMessage *apMessage);


// ----------------------------------
// CoAP Response and Confirm Messages
// ----------------------------------

// Return an acknowledge message with no payload if the original message was a confirmable message 
otError hppCoapConfirmWithCode(otMessage* apMessage, const otMessageInfo* apMessageInfo, otCoapCode aCoapCode);

// Return an acknowledge message with no playload with code 2.00 (OT_COAP_CODE_RESPONSE_MIN) if the original message was a confirmable message 
otError hppCoapConfirm(otMessage* apMessage, const otMessageInfo* apMessageInfo);

// Resond to a CoAP Message with MessageInfo from original message. Both confirmable and non comfirmable is supported. 
// The the response payload is piggybacked with the acknoledgment in case of confirmable requests.
// Adds a CoAP format option of 'aContentFormat' is different from the defaut format 'OT_COAP_OPTION_CONTENT_FORMAT_TEXT_PLAIN' 
otError hppCoapRespond(otMessage* apMessage, const otMessageInfo* apMessageInfo, const char* apPayload, size_t cbPayloadLen, otCoapOptionContentFormat aContentFormat);

// Resond text string to a CoAP Message with MessageInfo from original message. Both confirmable and non comfirmable is supported.
// The the response payload is piggybacked with the acknoledgment in case of confirmable requests.
otError hppCoapRespondString(otMessage* apMessage, const otMessageInfo* apMessageInfo, const char* aszPayloadString);

// Resond text string to a CoAP Message with MessageInfo from original message. Both confirmable and non comfirmable is supported.
// The the response payload is piggybacked with the acknoledgment in case of confirmable requests.
// Adds a CoAP format option of 'aContentFormat' is different from the defaut format 'OT_COAP_OPTION_CONTENT_FORMAT_TEXT_PLAIN' 
otError hppCoapRespondFormattedString(otMessage* apMessage, const otMessageInfo* apMessageInfo, const char* aszPayloadString, otCoapOptionContentFormat aContentFormat);

// Resond with CoAP code empty to a CoAP Message with given MessageInfo from original message if it was confirmable. 
// The empty response has no payload and and indicates to the client that a later response with the same token may come.
otError hppCoapRespondEmpty(otMessage* apMessage, const otMessageInfo* apMessageInfo);

// Store CoAP message context for a delayed answer
void hppCoapStoreMessageContext(hppCoapMessageContext* apCoapMessageContext, otMessage* apMessage, const otMessageInfo* apMessageInfo);

// Respond to a CoAP Message with given hppCoapMessageContext form original message. Both confirmable and non comfirmable is supported. 
// Adds a CoAP format option of 'aContentFormat' is different from the defaut format 'OT_COAP_OPTION_CONTENT_FORMAT_TEXT_PLAIN'
// If apPayload is NULL, a response without palyoad and  CoAP code OT_COAP_CODE_NOT_FOUND is sent.   
otError hppCoapRespondTo(const hppCoapMessageContext* apCoapMessageContext, const char* apPayload, size_t cbPayloadLen, otCoapOptionContentFormat aContentFormat);


// -----------------
// Read Coap Options
// -----------------

// Search for the first occurrence of a a specified coap option and return the value in apOptionBuffer
// Returns the length of the content in bytes or 0 if the option as not found or the buffer was to small.
const uint16_t hppGetCoapOption(otMessage* apMessage, otCoapOptionType aCoapOption, uint8_t* apOptionBuffer, uint16_t cbMaxLen);

// Read content format from coap message
otCoapOptionContentFormat hppGetCoapContentFormat(otMessage* apMessage);

// Verify if a certain content format is accepted for an answer
// TODO: Check if multiple accepted formats really come as different coap options of if they e.g. come as
// an array of int16_t
bool hppIsAcceptedCoapContentFormat(otMessage* apMessage, otCoapOptionContentFormat aContentFormat);

// Get CoAP Path option. Returns a heap allocated pointer which needs to be freed in the calling program. 
char* hppGetCoapPath(otMessage* apMessage);

// Invalidate current coap meassge context after H++ script execution triggered by a CoAP message              
void hppInvalidateHppCallContext();

// -------------------
// Secure CoAP (CoAPs)
// -------------------

// Default handler for connection events
void hppCoapsConnectedDefaultHandler(bool aConnected, void *aContext);

// Set PSK for Coaps connections and start Coaps module 
// Sets 'aConnectHandler' as a handler and passes 'aContext' to the handler in case of a connect or disconnect event.
// If 'aConnectHandler' is NULL a default handler (hppCoapsConnectedDefaultHandler) is ussed. 
// Return true if the process was successfully started, or false if something went wrong. 
// Currently only one CoAPs security context is supported.
otError hppCreateCoapsContextWithPSK(const char* szIdentityName, const char* szPassword, otHandleCoapSecureClientConnect aConnectHandler, void* aContext);

// Set Certificates for Coaps connections and start Coaps module  
// Sets 'aConnectHandler' as a handler and passes 'aContext' to the handler in case of a connect or disconnect event.
// If 'aConnectHandler' is NULL a default handler (hppCoapsConnectedDefaultHandler) is ussed. 
// Return true if the process was successfully started, or false if something went wrong.
// Currently only one CoAPs security context is supported.
otError hppCreateCoapsContextWithCert(const char* szX509Cert, const char* szPrivateKey, const char* szRootCert, otHandleCoapSecureClientConnect aConnectHandler, void* aContext);

// Start DTLS Connection with a host with the address 'aszUriPathAddress'
// Sets 'aConnectHandler' as a handler and passes 'aContext' to the handler in case of a connect or disconnect event.
// If 'aConnectHandler' is NULL a default handler (hppCoapsConnectedDefaultHandler) is ussed. 
// Return true if the process was successfully started, or false if something went wrong. 
otError hppCoapsConnect(const char* aszUriPathAddress, otHandleCoapSecureClientConnect aConnectHandler, void* aContext);

// Disconnect open DTLS connection
void hppCoapsDisconnect();

// Stop Coaps session
void hppDeleteCoapsContext();


// -----------------------
// Manage CoAP Resources
// -----------------------

// Add CoAP resource for a specified resource name and assign a handler
// Adds the resource and 'szResourceInformation' to the '.wellknown/core' resource string if szResourceInformation != NULL
// Only adds the resource name if 'szResourceInformation' is an empty string 
// The parameter 'abSecure' determines if a CoAPs resource (true) or regular CoAP (false) resource is added
bool hppCoapAddResource(const char* apResourceName, const char* szResourceInformation, otCoapRequestHandler apHandler, void* apContext, bool abSecure);

// Return string with all CoAP resources in CoAP .wellknown/core format or NULL in case of an error.
// The calling function must free the memory allocated by this function unless NULL was returned. 
char* hppNew_WellknownCore();


// -------------------
// Manage IP Addresses
// -------------------

// Add unicast or multicast address to the interface
bool hppAddAddress(const char* aAddress);

// Convert IPv6 address in a string and write it in aszText_out.
// aszText_out mut be 40 bytes long to hold the address string including terminating null byte.
// Returns aszText_out.
// Does NOT check if aszText_out is NULL!
// This does not require locking the thread mutex
char* hppGetAddrString(const otIp6Address *apIp6Address, char* aszText_out);


// ---------
// CLI Tools
// ---------

// Print string to CLI console with LF to CRLF translation. Adds  another CRLF if abNewLine is true. 
void hppCliOutputStr(const char* aszText, bool abNewLine);


// ----------------------------------
// Thread Initialization on nRF 52840
// ----------------------------------

void hppThreadInit();


// ---------------------------------
// Main Loop for Thread on nRF 52840
// ---------------------------------

void hppMainLoop();

#endif
```

## src/hppNRF52840.c
```c
/* ----------------------------------------------------------------------------	*/
/* Halloween++														            */
/* ----------------------------------------------------------------------------	*/
/* Open source scripting language for microcontrollers and embedded	            */
/* systems.															            */
/* Invented for remote controlled Halloween ghosts and candles :-)	            */
/* ----------------------------------------------------------------------------	*/
/* File: hppNRF52840.c												            */
/* ----------------------------------------------------------------------------	*/
/* OpenThread Support Library										            */
/*																	            */
/*   - PWM library              	       							           	*/
/* ----------------------------------------------------------------------------	*/
/* Platform: Zephyr RTOS with Nordic nRF52840						            */
/* Nordic SDK Version: Connect SDK v1.5.1	       								*/
/* ----------------------------------------------------------------------------	*/
/* Copyright (c) 2018 - 2021, Arnulf Rupp							            */
/* arnulf.rupp@web.de												            */
/* All rights reserved.												            */
/* 	                                                                            */
/* Redistribution and use in source and binary forms, with or without           */
/* modification, are permitted provided that the following conditions are met:  */
/* 	                                                                            */
/* 1. Redistributions of source code must retain the above copyright notice,    */
/* this list of conditions and the following disclaimer.                        */
/* 	                                                                            */
/* 2. Redistributions in binary form must reproduce the above copyright notice, */
/* this list of conditions and the following disclaimer in the documentation    */
/* and/or other materials provided with the distribution.                       */
/* 	                                                                            */
/* THIS SOFTWARE IS PROVIDED BY THE COPYRIGHT HOLDERS AND CONTRIBUTORS "AS IS"  */
/* AND ANY EXPRESS OR IMPLIED WARRANTIES, INCLUDING, BUT NOT LIMITED TO, THE    */
/* IMPLIED WARRANTIES OF MERCHANTABILITY AND FITNESS FOR A PARTICULAR PURPOSE   */
/* ARE DISCLAIMED. IN NO EVENT SHALL THE COPYRIGHT HOLDER OR CONTRIBUTORS BE    */
/* LIABLE FOR ANY DIRECT, INDIRECT, INCIDENTAL, SPECIAL, EXEMPLARY, OR          */
/* CONSEQUENTIAL DAMAGES (INCLUDING, BUT NOT LIMITED TO, PROCUREMENT OF         */
/* SUBSTITUTE GOODS OR SERVICES; LOSS OF USE, DATA, OR PROFITS; OR BUSINESS     */
/* INTERRUPTION) HOWEVER CAUSED AND ON ANY THEORY OF LIABILITY, WHETHER IN      */
/* CONTRACT, STRICT LIABILITY, OR TORT (INCLUDING NEGLIGENCE OR OTHERWISE)      */
/* ARISING IN ANY WAY OUT OF THE USE OF THIS SOFTWARE, EVEN IF ADVISED OF       */
/* THE POSSIBILITY OF SUCH DAMAGE.                                              */
/* ----------------------------------------------------------------------------	*/

#include "../include/hppNRF52840.h"

#include <zephyr.h>

// --------------------
// PWM Functions 
// --------------------

// Start a PMW Sequence for up to four GIO pins (-1 = not active).
// The frequency is 16MHz / uiCountStop. Duty cycle values are provided in the array puiSeqence in groups of 
// one, two or four duty cycle values in uint16_t format, depending on how many pins are active.
// If only iPin1 is activ (>= 0) than one uint16_t is consumed per sequence to set the PWM value for pin1.
// If iPin1 and iPin2 are active but not iPin3 and iPin4, two uint16_t are consumed per sequence respectively.
// Otherwise always(!) four uint16_t are consumed. The use of three channels is not possible by a hardware restriction
// even if iPin4 is not activ (-1). 

// The cSequenceLen is the number of sequence values (1x, 2x or 4x uint16_t values respectively) provided.
// The values are not not buffered. Therefore puiSeqence must remain in RAM wihile PWM is active.
// Duty cycle values range from 0 to uiCountStop (100%). 
// Every PWM setting is repeated 'uiStepRepeat' times until the next values are taken. If 'uiStepRepeat' is null then
// the PMW values are static. The Sequence is repeated uiLoop times (uiLoop = 0 --> no Loop)
// If uiLoop is >0 cSequenceLen must be minimum 2.

void hppStartPWM(unsigned int uiCountStop, int iPin1, int iPin2, int iPin3, int iPin4, uint16_t* puiSeqence, size_t cSequenceLen, unsigned int uiStepRepeat, unsigned int uiLoop)
{
    if(uiLoop > 0 && cSequenceLen < 2) return;  //error

    NRF_PWM0->TASKS_SEQSTART[0] = 0;
    NRF_PWM0->TASKS_SEQSTART[1] = 0;

    if(iPin1 < 0) NRF_PWM0->PSEL.OUT[0] = PWM_PSEL_OUT_CONNECT_Disconnected << PWM_PSEL_OUT_CONNECT_Pos;
    else          NRF_PWM0->PSEL.OUT[0] = (iPin1 << PWM_PSEL_OUT_PIN_Pos) | (PWM_PSEL_OUT_CONNECT_Connected << PWM_PSEL_OUT_CONNECT_Pos);
    
    if(iPin3 >= 0 || iPin4 >= 0)
    {
        if(iPin2 < 0) NRF_PWM0->PSEL.OUT[1] = PWM_PSEL_OUT_CONNECT_Disconnected << PWM_PSEL_OUT_CONNECT_Pos;
        else          NRF_PWM0->PSEL.OUT[1] = (iPin2 << PWM_PSEL_OUT_PIN_Pos) | (PWM_PSEL_OUT_CONNECT_Connected << PWM_PSEL_OUT_CONNECT_Pos);
        
        if(iPin3 < 0) NRF_PWM0->PSEL.OUT[2] = PWM_PSEL_OUT_CONNECT_Disconnected << PWM_PSEL_OUT_CONNECT_Pos;
        else          NRF_PWM0->PSEL.OUT[2] = (iPin3 << PWM_PSEL_OUT_PIN_Pos) | (PWM_PSEL_OUT_CONNECT_Connected << PWM_PSEL_OUT_CONNECT_Pos);
    }
    else  // Attache PWM Counter 1 to pin and 3 PWM Counter 3 to pin 2 if only one or two pins are active   
    {
        if(iPin2 < 0) NRF_PWM0->PSEL.OUT[2] = PWM_PSEL_OUT_CONNECT_Disconnected << PWM_PSEL_OUT_CONNECT_Pos;
        else          NRF_PWM0->PSEL.OUT[2] = (iPin2 << PWM_PSEL_OUT_PIN_Pos) | (PWM_PSEL_OUT_CONNECT_Connected << PWM_PSEL_OUT_CONNECT_Pos);
        
        if(iPin3 < 0) NRF_PWM0->PSEL.OUT[1] = PWM_PSEL_OUT_CONNECT_Disconnected << PWM_PSEL_OUT_CONNECT_Pos;
        else          NRF_PWM0->PSEL.OUT[1] = (iPin3 << PWM_PSEL_OUT_PIN_Pos) | (PWM_PSEL_OUT_CONNECT_Connected << PWM_PSEL_OUT_CONNECT_Pos);
    }
    
        
    if(iPin4 < 0) NRF_PWM0->PSEL.OUT[3] = PWM_PSEL_OUT_CONNECT_Disconnected << PWM_PSEL_OUT_CONNECT_Pos;
    else          NRF_PWM0->PSEL.OUT[3] = (iPin4 << PWM_PSEL_OUT_PIN_Pos) | (PWM_PSEL_OUT_CONNECT_Connected << PWM_PSEL_OUT_CONNECT_Pos);

    NRF_PWM0->ENABLE = (PWM_ENABLE_ENABLE_Enabled << PWM_ENABLE_ENABLE_Pos);
    NRF_PWM0->MODE = (PWM_MODE_UPDOWN_Up << PWM_MODE_UPDOWN_Pos);
    NRF_PWM0->PRESCALER = (PWM_PRESCALER_PRESCALER_DIV_1 << PWM_PRESCALER_PRESCALER_Pos); 
    NRF_PWM0->COUNTERTOP = (uiCountStop << PWM_COUNTERTOP_COUNTERTOP_Pos);  // 16000 => 1 msec

    if (uiLoop == 0) NRF_PWM0->LOOP = (PWM_LOOP_CNT_Disabled << PWM_LOOP_CNT_Pos);
    else             NRF_PWM0->LOOP = (uiLoop << PWM_LOOP_CNT_Pos);

    if(iPin3 < 0 && iPin4 < 0)
    {
        if(iPin2 < 0) NRF_PWM0->DECODER = (PWM_DECODER_LOAD_Common << PWM_DECODER_LOAD_Pos) | (PWM_DECODER_MODE_RefreshCount << PWM_DECODER_MODE_Pos);
        else 
        {
            cSequenceLen = cSequenceLen * 2;   // two int16_t per sequence item
            NRF_PWM0->DECODER = (PWM_DECODER_LOAD_Grouped << PWM_DECODER_LOAD_Pos) | (PWM_DECODER_MODE_RefreshCount << PWM_DECODER_MODE_Pos);  
        }
    }
    else 
    {
        cSequenceLen = cSequenceLen * 4;  // four int16_t per sequence item
        NRF_PWM0->DECODER = (PWM_DECODER_LOAD_Individual << PWM_DECODER_LOAD_Pos) | (PWM_DECODER_MODE_RefreshCount << PWM_DECODER_MODE_Pos);
    }

    if(uiLoop == 0)
    {
        NRF_PWM0->SEQ[0].PTR = (uint32_t)(puiSeqence) << PWM_SEQ_PTR_PTR_Pos;
        NRF_PWM0->SEQ[0].CNT = cSequenceLen << PWM_SEQ_CNT_CNT_Pos;
        NRF_PWM0->SEQ[0].REFRESH = uiStepRepeat;
        NRF_PWM0->SEQ[0].ENDDELAY = 0;
    }
    else
    {
        NRF_PWM0->SEQ[0].PTR = (uint32_t)(puiSeqence) << PWM_SEQ_PTR_PTR_Pos;
        NRF_PWM0->SEQ[0].CNT = 4 << PWM_SEQ_CNT_CNT_Pos;
        NRF_PWM0->SEQ[0].REFRESH = uiStepRepeat;
        NRF_PWM0->SEQ[0].ENDDELAY = 0;
        NRF_PWM0->SEQ[1].PTR = (uint32_t)(puiSeqence + 4) << PWM_SEQ_PTR_PTR_Pos;
        NRF_PWM0->SEQ[1].CNT = (cSequenceLen - 4) << PWM_SEQ_CNT_CNT_Pos;
        NRF_PWM0->SEQ[1].REFRESH = uiStepRepeat;
        NRF_PWM0->SEQ[1].ENDDELAY = 0;
    }

    NRF_PWM0->TASKS_SEQSTART[0] = 1; 
}

void hppRestartPWM()
{
    NRF_PWM0->TASKS_SEQSTART[0] = 0;
    NRF_PWM0->ENABLE = (PWM_ENABLE_ENABLE_Enabled << PWM_ENABLE_ENABLE_Pos);
    NRF_PWM0->TASKS_SEQSTART[0] = 1;
}

void hppStopPWM()
{
    NRF_PWM0->TASKS_SEQSTART[0] = 0;
    NRF_PWM0->ENABLE = (PWM_ENABLE_ENABLE_Disabled << PWM_ENABLE_ENABLE_Pos);
}
```
